## config/boards/shields/luna/Kconfig.defconfig
```kconfig
# Copyright (c) 2020 The ZMK Contributors
# SPDX-License-Identifier: MIT

if SHIELD_LUNA_LEFT

config ZMK_KEYBOARD_NAME
	default "LUNA_L"

config ZMK_SPLIT_BLE_ROLE_CENTRAL
	default y

endif

if SHIELD_LUNA_RIGHT

config ZMK_KEYBOARD_NAME
	default "LUNA_R"

endif

if SHIELD_LUNA_RIGHT || SHIELD_LUNA_LEFT

config ZMK_SPLIT
	default y

endif
```

## config/boards/shields/luna/Kconfig.shield
```kconfig
# Copyright (c) 2020 The ZMK Contributors
# SPDX-License-Identifier: MIT

config SHIELD_LUNA_LEFT
	def_bool $(shields_list_contains,luna_left)

config SHIELD_LUNA_RIGHT
	def_bool $(shields_list_contains,luna_right)
```
